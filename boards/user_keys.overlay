/*
 * Copyright (c) 2024 Semtech Corporation
 *
 * SPDX-License-Identifier: Apache-2.0
 */

/ {
	zephyr,user {
		user-lorawan-device-eui = <>;
		user-lorawan-join-eui = <>;
		user-lorawan-gen_app-key = <>;
		user-lorawan-app-key = <>;
		user-lorawan-region = "EU_868";
	};
};
