## build/Kconfig/Kconfig.shield.defconfig
```kconfig
osource "C:/Users/PMLS/zephyr_workspace/usp_zephyr/boards/shields/*/Kconfig.defconfig"
```

## build/Kconfig/arch/Kconfig
```kconfig
# Load Zephyr Arch Kconfig descriptions.
osource "C:/Users/PMLS/zephyr_workspace/zephyr/arch/rx/Kconfig"
osource "C:/Users/PMLS/zephyr_workspace/zephyr/arch/x86/Kconfig"
osource "C:/Users/PMLS/zephyr_workspace/zephyr/arch/xtensa/Kconfig"
osource "C:/Users/PMLS/zephyr_workspace/zephyr/arch/sparc/Kconfig"
osource "C:/Users/PMLS/zephyr_workspace/zephyr/arch/riscv/Kconfig"
osource "C:/Users/PMLS/zephyr_workspace/zephyr/arch/posix/Kconfig"
osource "C:/Users/PMLS/zephyr_workspace/zephyr/arch/mips/Kconfig"
osource "C:/Users/PMLS/zephyr_workspace/zephyr/arch/arm64/Kconfig"
osource "C:/Users/PMLS/zephyr_workspace/zephyr/arch/arm/Kconfig"
osource "C:/Users/PMLS/zephyr_workspace/zephyr/arch/arc/Kconfig"
```

## build/Kconfig/boards/Kconfig
```kconfig
# Load Zephyr board Kconfig descriptions.
osource "C:/Users/PMLS/zephyr_workspace/zephyr/boards/nordic/nrf52840dk/Kconfig"
```

## build/Kconfig/boards/Kconfig.defconfig
```kconfig
# Load Zephyr board defconfig descriptions.
osource "C:/Users/PMLS/zephyr_workspace/zephyr/boards/nordic/nrf52840dk/Kconfig.defconfig"
```
